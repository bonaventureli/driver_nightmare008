/*-----------------------------------------------------------------------------
 * Name:    MP230_Nightmare.c
 * Purpose: MP230 Nightmare music player is for Nightmare for room1-room2
 * "www.ewoodpecker.cn" ETZ-MP230
 * Rev.:    1.00
 *----------------------------------------------------------------------------*/
/* Copyright (c) 2016/5/16 LIFEI
   ---------------------------------------------------------------------------*/

#include "ME007Y50H.H"

/*******************************
variable
********************************/
uint8_t TxBuffer[][5] = {
{0x55,0xAA,0x01,0x01,0x01},
{0x55,0xAA,0x01,0x01,0x01},
};

uint8_t TxBuffer_music[][10] = {
{0x7E,0x10,0x06,0x0f,0x00,0x01,0x00,0xFF,0xE0,0xEF},
{0x7E,0x10,0x06,0x0f,0x00,0x01,0x01,0xFF,0xD9,0xEF},
{0x7E,0x10,0x06,0x0f,0x00,0x01,0x02,0xFF,0xD8,0xEF},
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{0x7E,0x10,0x06,0x0f,0x00,0x01,0x28,0xFF,0xB2,0xEF},

};

uint8_t MusicOverBuffer[][10]={
{0x7E,0x7F,0x06,0x3D,0x00,0x00,0x00,0x7E,0x3E,0x6F},
{0x7E,0x7F,0x06,0x3D,0x00,0x00,0x01,0x7E,0x3D,0x6F},
{0x7E,0x7F,0x06,0x3D,0x00,0x00,0x02,0x7E,0x3C,0x6F},
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{0x7E,0x7F,0x06,0x3D,0x00,0x00,0x28,0x7E,0x16,0x6F},

};

uint8_t RxBuffer_music[10];
extern uint32_t Button_MASK_main;
extern uint8_t flag_button28;
__IO uint8_t TxCounter = 0,RxCounter = 0;
//__IO uint8_t TxxCounter = 24;
//uint8_t RxBuffer[InstructionLength];
uint8_t RxBuffer[7];
int32_t USARTx_Initialize (USART_TypeDef* USARTx);

/********************************
*@brif Initialize the MP230
*@para USARTx:USART1 USART2 USART3 UART4 UART5
*@return 0 
********************************/
int32_t MP230_Initialize (USART_TypeDef* USARTx) {
		USARTx_Initialize(USARTx);
  return 0;
}
/********************************
*@brif send one instruction
*@para USARTx:USART1 USART2 USART3 UART4 UART5
			 TempBufferLength: The length of the instructions
			 InstructionID: the instructions identifier
*@return none
********************************/
void SendOneInstructionA(USART_TypeDef* USARTx,\
												 uint16_t TempBufferLength,\
												 uint8_t InstructionID){
	/*Send one instruction*/
	uint8_t TempCounter = 0;
	while(TempCounter < TempBufferLength){
	/* Send one byte from USARTx */
	USART_SendData(USARTx, TxBuffer[InstructionID][TempCounter++]);
	/* Loop until USART1 DR register is empty */ 
	while(USART_GetFlagStatus(USARTx, USART_FLAG_TXE) == RESET){
	}
	}
	/*wait the return values from the Music modern*/
	RxCounter = 0;
	while(RxCounter < TempBufferLength){
	/* Loop until the USARTx Receive Data Register is not empty */
	while(USART_GetFlagStatus(USARTx, USART_FLAG_RXNE) == RESET){
	}
	/* Store the received byte in RxBuffer */
	RxBuffer[RxCounter++] = (USART_ReceiveData(USARTx) & 0x7F);
	}
}


/********************************
*@brif send one instruction
*@para USARTx:USART1 USART2 USART3 UART4 UART5
			 TempBufferLength: The length of the instructions
			 InstructionID: the instructions identifier
*@return return InstructionID, indate the music is over.
********************************/
uint8_t SendOneInstructionB(USART_TypeDef* USARTx,\
												 uint16_t TempBufferLength,\
												 uint8_t InstructionID){
	/*Send one instruction*/
	uint8_t TempCounter = 0;
	while(TempCounter < TempBufferLength){
	/* Send one byte from USARTx */
	USART_SendData(USARTx, TxBuffer[InstructionID][TempCounter++]);
	/* Loop until USART1 DR register is empty */ 
	while(USART_GetFlagStatus(USARTx, USART_FLAG_TXE) == RESET){
	}
	}
	/*wait the return values from the Music modern*/
	RxCounter = 0;
	while(RxCounter < TempBufferLength){
	/* Loop until the USARTx Receive Data Register is not empty */
	while(USART_GetFlagStatus(USARTx, USART_FLAG_RXNE) == RESET){
	}
	/* Store the received byte in RxBuffer */
	RxBuffer[RxCounter++] = (USART_ReceiveData(USARTx) & 0x7F);
	}
	return InstructionID;
}
												 
uint8_t SendOneInstructionB_music(USART_TypeDef* USARTx,\
												 uint16_t TempBufferLength,\
												 uint8_t InstructionID){
	/*Send one instruction*/
	uint8_t TempCounter = 0;
	while(TempCounter < TempBufferLength){
	/* Send one byte from USARTx */
	USART_SendData(USARTx, TxBuffer_music[InstructionID][TempCounter++]);
	/* Loop until USART1 DR register is empty */ 
	while(USART_GetFlagStatus(USARTx, USART_FLAG_TXE) == RESET){
	}
	}
	/*wait the return values from the Music modern*/
	RxCounter = 0;
	while(RxCounter < TempBufferLength){
	/* Loop until the USARTx Receive Data Register is not empty */
	while(USART_GetFlagStatus(USARTx, USART_FLAG_RXNE) == RESET){
	}
	/* Store the received byte in RxBuffer */
	RxBuffer_music[RxCounter++] = (USART_ReceiveData(USARTx) & 0x7F);
	}
	return InstructionID;
}
/********************************
*@brif send one instruction
*@para USARTx:USART1 USART2 USART3 UART4 UART5
			 TempBufferLength: The length of the instructions
			 InstructionID: the instructions identifier
*@return return InstructionID, indate the music is over.
********************************/
uint8_t SendInstruction(USART_TypeDef* USARTx,\
												 uint8_t InstructionID){
	/*Send one instruction*/
	uint8_t TempCounter = 0;
	while(TempCounter < 5){
	/* Send one byte from USARTx */
	USART_SendData(USARTx, TxBuffer[InstructionID][TempCounter++]);
	/* Loop until USART1 DR register is empty */ 
	while(USART_GetFlagStatus(USARTx, USART_FLAG_TXE) == RESET){
	}
	}
	/*wait the return values from the Music modern*/
	RxCounter = 0;
	while(RxCounter < 7){
	/* Loop until the USARTx Receive Data Register is not empty */
	while(USART_GetFlagStatus(USARTx, USART_FLAG_RXNE) == RESET){
	}
	/* Store the received byte in RxBuffer */
	RxBuffer[RxCounter++] = (USART_ReceiveData(USARTx) & 0xFF);
	}
	return InstructionID;
}
uint8_t SendOneInstructionB2(USART_TypeDef* USARTx,\
												 uint16_t TempBufferLength,\
												 uint8_t InstructionID){
	/*Send one instruction*/
	uint8_t TempCounter = 0;
	while(TempCounter < TempBufferLength){
	/* Send one byte from USARTx */
	USART_SendData(USARTx, TxBuffer[InstructionID][TempCounter++]);
	/* Loop until USART1 DR register is empty */ 
	while(USART_GetFlagStatus(USARTx, USART_FLAG_TXE) == RESET){
	}
	}
	/*wait the return values from the Music modern*/
	RxCounter = 0;
	flag_button28=0;
	while(RxCounter < TempBufferLength){
	/* Loop until the USARTx Receive Data Register is not empty */
	while(USART_GetFlagStatus(USARTx, USART_FLAG_RXNE) == RESET){
		if(flag_button28==1){break;}
	}
	/* Store the received byte in RxBuffer */
	RxBuffer[RxCounter++] = (USART_ReceiveData(USARTx) & 0x7F);
	}
	return InstructionID;
}

uint8_t* SendOneInstruction(USART_TypeDef* USARTx,\
	uint8_t TempTxBuffer[][10],\
	uint8_t TempRxBuffer[10],\
	uint16_t TempTxxCounter,\
	uint16_t TempBufferLength){
	//Send one instruction
	uint8_t TempTxCounter = 0;
	uint8_t TempRxCounter = 0;
	while(TempTxCounter < TempBufferLength){
	/* Send one byte from USARTx */
	USART_SendData(USARTx, TempTxBuffer[TempTxxCounter][TempTxCounter++]);
	/* Loop until USART1 DR register is empty */ 
	while(USART_GetFlagStatus(USARTx, USART_FLAG_TXE) == RESET){
	}
	}		 
	/*wait the return values from the Music modern*/
	TempRxCounter = 0;
	while(TempRxCounter < TempBufferLength){
	/* Loop until the USARTx Receive Data Register is not empty */
	while(USART_GetFlagStatus(USARTx, USART_FLAG_RXNE) == RESET){
	}
	/* Store the received byte in RxBuffer */
	(TempRxBuffer[TempRxCounter++]) = (USART_ReceiveData(USARTx) & 0x7F);
	}
	return TempRxBuffer;
}

/********************************
*@brif Just send one instruction
*@para USARTx:USART1 USART2 USART3 UART4 UART5
			 TempBufferLength: The length of the instructions
			 InstructionID: the instructions identifier
*@return none
********************************/
void JustSendOneInstruction(USART_TypeDef* USARTx,\
												 uint16_t TempBufferLength,\
												 uint8_t InstructionID){
	/*Send one instruction*/
	uint8_t TempCounter = 0;
	while(TempCounter < TempBufferLength){
	/* Send one byte from USARTx */
	USART_SendData(USARTx, TxBuffer[InstructionID][TempCounter++]);
	/* Loop until USART1 DR register is empty */ 
	while(USART_GetFlagStatus(USARTx, USART_FLAG_TXE) == RESET){
	}
 }
}
